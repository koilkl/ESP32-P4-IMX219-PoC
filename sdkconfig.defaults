## sdkconfig.defaults
```kconfig
CONFIG_AUTOSTART_ARDUINO=y
CONFIG_ARDUINO_VARIANT="esp32p4"
CONFIG_ENABLE_ARDUINO_DEPENDS=y

CONFIG_ESPTOOLPY_FLASHSIZE_4MB=y

CONFIG_PARTITION_TABLE_CUSTOM=y
CONFIG_PARTITION_TABLE_CUSTOM_FILENAME="partitions.csv"
```
